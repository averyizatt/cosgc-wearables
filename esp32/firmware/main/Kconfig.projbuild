## esp32/firmware/main/Kconfig.projbuild
```kconfig
menu "tinyasr"
    choice TASR_MODE
        prompt "Input source"
        default TASR_MODE_FILE
        config TASR_MODE_FILE
            bool "Benchmark: utterances stored in the 'audio' partition"
        config TASR_MODE_MIC
            bool "Live: I2S MEMS microphone (e.g. INMP441)"
    endchoice
    config TASR_I2S_BCLK
        int "I2S BCLK (SCK) GPIO"
        default 4
    config TASR_I2S_WS
        int "I2S WS (LRCL) GPIO"
        default 5
    config TASR_I2S_DIN
        int "I2S data-in (SD) GPIO"
        default 6
    config TASR_MIC_CODEC
        bool "Microphone through an ES8311 codec (e.g. Waveshare ESP32-P4-Pico) instead of a bare I2S MEMS mic"
        default n
        help
            The codec is set up over I2C (16 kHz, MCLK 256 x fs, I2S slave) and the microphone data come on the same I2S
            port. UNVERIFIED on hardware: written from Espressif's es8311 driver and Waveshare's pin table.
    config TASR_I2S_MCLK
        int "I2S MCLK GPIO (codec only)"
        default 13
        depends on TASR_MIC_CODEC
    config TASR_CODEC_I2C_SDA
        int "Codec I2C SDA GPIO"
        default 7
        depends on TASR_MIC_CODEC
    config TASR_CODEC_I2C_SCL
        int "Codec I2C SCL GPIO"
        default 8
        depends on TASR_MIC_CODEC
    config TASR_CODEC_ADDR
        hex "Codec I2C address"
        default 0x18
        depends on TASR_MIC_CODEC
    config TASR_CODEC_MIC_GAIN
        int "Codec microphone gain in steps of 6 dB (0-7)"
        default 4
        range 0 7
        depends on TASR_MIC_CODEC
    config TASR_PA_GPIO
        int "Speaker amplifier enable GPIO, driven low (off) at start; -1 = leave alone"
        default -1
        range -1 54
        depends on TASR_MIC_CODEC
    config TASR_PTT_GPIO
        int "Push-to-talk button GPIO (button to GND, internal pull-up); -1 = none"
        default -1
        range -1 54
        help
            With a button, an utterance is what you say while holding it (plus 0.3 s from before the press) and the
            final text comes as soon as it is released, with no end-of-speech pause; noise is never transcribed.
            Without one (-1), the energy VAD starts and ends utterances.
    config TASR_BLE
        bool "Bluetooth LE service for the device API (docs/API.md)"
        default n
        help
            Adds NimBLE and a GATT service in the Nordic UART layout that carries the same JSON lines as the USB port.
            Needs the 1 MB app partition (partitions_nemo16ble.csv) and about 30-60 KB of internal RAM; see sdkconfig.ble.

    config TASR_BLE_PASSKEY
        bool "Bluetooth pairing needs a 6-digit PIN shown on the screen"
        default y
        depends on TASR_BLE
        help
            Without it pairing is "just works": encrypted, but anyone in range can pair (development only).

    config TASR_BLE_NAME
        string "Bluetooth device name"
        default "cosgc-oido"
        depends on TASR_BLE

    config TASR_INTERNAL_RESERVE_KB
        int "Internal RAM kept free when the engine asks for a hot work buffer (KB)"
        default 32
        help
            Buffers the engine wants in fast internal RAM fall back to PSRAM below this much free. Nothing allocates
            later at run time, so a small value is enough once everything is set up (the Bluetooth build uses 8).

    config TASR_WORKER_STACK
        int "Stack of the second core's worker task (bytes)"
        default 16384
        help
            Measured high-water use: about 6 KB (two-core build). The Bluetooth build uses 10 KB to free internal RAM.

    config TASR_I2S_DMA_DESC
        int "I2S DMA buffers of 20 ms each"
        default 8
        range 2 16

    config TASR_LED_GPIO
        int "Status LED: addressable RGB LED (WS2812) GPIO; -1 = none"
        default -1
        range -1 54
        help
            GPIO48 on ESP32-S3-DevKitC-1 v1.0 (and most N16R8 clones), GPIO38 on v1.1. Dim blue: loading; dim green:
            ready; blue: hearing you; amber: computing the final text; green flash: text ready; red flash: nothing
            recognized; purple: audio buffer full (recognition is behind, audio is dropped).
    config TASR_FINAL_FULL
        bool "Microphone mode: partial text from streaming, final text from a full-context pass over the utterance"
        default n
        help
            Streaming models only. When speech ends (button released, or the pause), the whole utterance runs through the
            encoder with full context, which is much more accurate (docs/EXPERIMENTS.md, E12) but takes about 0.64 times
            the utterance's length on two ESP32-P4 cores. Utterances beyond the 20 s recording buffer keep the streaming text.
    config TASR_SEG_HANG_MS
        int "Pause (ms) that ends an utterance in microphone mode"
        default 800
        help
            Silence after speech before the utterance is closed and its final text printed. With a streaming
            model almost all compute is done by then, so this pause is most of the latency; voice agents
            typically use 400-600 ms (or their own turn detector).
    config TASR_BENCH_PACED
        bool "File mode: also stream every clip at real-time pace and report when the final text appears"
        default n
        help
            Benchmark builds only. The clip is fed in 20 ms blocks, each one when its last sample would have been
            spoken, so the delay of the final text after the end of speech includes any backlog if the chip is slower
            than real time.

    config TASR_BENCH_STREAM_ONLY
        bool "File mode: streaming passes only (no utterance-mode pass; TOTAL is the streaming RTF)"
        default n

    config TASR_KERNEL_BENCH
        bool "Benchmark: at boot, time the int8 GEMM kernels with weights in internal RAM, PSRAM and flash"
        depends on IDF_TARGET_ESP32S3  # Xtensa assembly
        default n
        help
            Prints KBENCH lines: cycles per multiply-accumulate for each placement. If PSRAM and flash are close to
            internal RAM, the kernels are not waiting for weights.

    config TASR_P4_PIE
        bool "ESP32-P4: vector (PIE) kernels, checked against plain C at boot"
        default n
        depends on IDF_TARGET_ESP32P4
        help
            int8 dot products and the int4 GEMM on the P4's PIE instructions. NOT TESTED ON HARDWARE: at boot
            tasr_p4_selftest() compares each kernel with plain C and switches the vector path off if one differs
            (look for P4SELFTEST lines on the console). If the board crashes before that, turn this off.

    config TASR_O3
        bool "Compile the engine with -O3 -funroll-loops instead of -O2"
        default y
        help
            Same results (no fast-math, fused multiply-add stays off). Measured on an N16R8 board: 2.3 % faster
            than -O2 (real-time factor 1.833 against 1.877 on the oido_s3_bench clips).

    config TASR_EXP_NO_PSRAM_WEIGHTS
        bool "Experiment: keep all weights in flash (no copies in PSRAM)"
        default n

    config TASR_EXP_SPIN_PARFOR
        bool "Experiment: two-core parallel-for with spin-waiting instead of FreeRTOS semaphores"
        default n

    config TASR_EXP_NOINT
        bool "Experiment (with spin-wait): interrupts masked on both cores while a job runs"
        depends on TASR_EXP_SPIN_PARFOR
        default n

    config TASR_PAR_MASK
        int "Experiment: bit mask of the parallel call sites that use both cores (0 gives all-serial); unset = all"
        default 511
        depends on TASR_EXP_PAR_MASK_ON

    config TASR_EXP_PAR_MASK_ON
        bool "Experiment: enable TASR_PAR_MASK"
        default n

    config TASR_XR_MAX_KP
        int "int8 rows of up to this many bytes use the x-stationary kernel, longer ones the row kernel"
        default 256
        help
            1024 keeps tasr_dot_rows_s8 (the row kernel, which crashes when both cores run it) out of the K=704
            and language-model GEMMs.

    config TASR_EXP_DCACHE_AUTOLOAD
        int "Data-cache hardware prefetch over the model's flash mapping (blocks per prefetch 0-3; -1 = off)"
        default 3
        range -1 3

    config TASR_LM_INT4
        bool "Language model's GRU and output matrices re-quantized to int4 when loaded"
        default y
        help
            Halves the PSRAM traffic of each LM step (the LM is bound by it). LibriSpeech, streaming model,
            1000 utterances on the host: WER 4.80 / 10.67 against 4.87 / 10.70 with the int8 LM.

    config TASR_EXP_LM_SERIAL
        bool "Experiment (two cores): run the language model's matrix products on one core"
        default n

    config TASR_EXP_XQ_COPY
        bool "Experiment: worker 1 reads a private copy of the activation tile in the K=704 GEMMs"
        default n

    config TASR_EXP_XQ_PSRAM
        bool "Experiment: activation tile in PSRAM instead of internal SRAM"
        default n

    config TASR_EXP_DOT_DUP
        bool "Experiment: each core runs its own copy of the dot-product kernel"
        default n

    config TASR_EXP_DOT_IRAM
        bool "Experiment: dot-product kernel in IRAM"
        default n

    config TASR_EXP_ROWSPLIT
        bool "Experiment: split the K=704 matrix products over rows instead of output channels"
        default n

    config TASR_OLED
        bool "SSD1306 128x64 I2C OLED showing the live transcript"
        default n
    config TASR_OLED_SDA
        int "OLED SDA GPIO"
        default 8
        depends on TASR_OLED
    config TASR_OLED_SCL
        int "OLED SCL GPIO"
        default 9
        depends on TASR_OLED
    config TASR_OLED_ADDR
        hex "OLED I2C address"
        default 0x3C
        depends on TASR_OLED
    config TASR_CHUNK
        int "Encoder chunk (25 Hz frames, even); 32 = 1.28 s"
        default 32
    config TASR_LEFT
        int "Attention history in chunks"
        default 2
    config TASR_BEAM
        int "Beam width when an LM partition is present"
        default 4
    config TASR_LM_WEIGHT_X100
        int "LM weight x100"
        default 60
    config TASR_TOKEN_BONUS_X100
        int "Token insertion bonus x100"
        default 250
endmenu
```
